## kernel/Kconfig
```kconfig
menu "KernelSU"

config KSU
	tristate "KernelSU function support"
	default y
	help
	  Enable kernel-level root privileges on Android System.
	  Requires CONFIG_KPROBES for kernel hooking support.
	  Requires CONFIG_EXT4_FS for `ext4_unregister_sysfs`.
	  To compile as a module, choose M here: the
	  module will be called kernelsu.

config KSU_DEBUG
	bool "KernelSU debug mode"
	depends on KSU
	default n
	help
	  Enable KernelSU debug mode.

config KSU_DISABLE_MANAGER
	bool "Disable KernelSU manager integration"
	depends on KSU
	default n
	help
	  Disable manager APK detection and manager-specific handling.
	  Root will be used in place of manager-only functionality.

config KSU_DISABLE_POLICY
	bool "Disable KernelSU policy profiles"
	depends on KSU
	default n
	help
	  Disable per-app root/non-root profile customization.
	  Escalation will always use the default full root profile, and
	  non-root handling will follow the global umount policy only.

menu "KernelSU - SUSFS"

config KSU_SUSFS
	bool "KernelSU addon - SUSFS"
	depends on KSU
	depends on THREAD_INFO_IN_TASK
	default y
	help
	  Enable SUSFS integration for KernelSU.

config KSU_SUSFS_SUS_PATH
	bool "Enable suspicious-path hiding"
	depends on KSU_SUSFS
	default y
	help
	  Allow configured paths and their subpaths to be filtered.

config KSU_SUSFS_SUS_MOUNT
	bool "Enable suspicious-mount hiding"
	depends on KSU_SUSFS
	default y
	help
	  Hide configured mounts and provide adjusted mount identifiers.

config KSU_SUSFS_SUS_KSTAT
	bool "Enable suspicious-kstat spoofing"
	depends on KSU_SUSFS
	default y
	help
	  Allow configured file and directory metadata to be replaced.

config KSU_SUSFS_SPOOF_UNAME
	bool "Enable uname spoofing"
	depends on KSU_SUSFS
	default y
	help
	  Allow the uname result to be replaced with configured values.

config KSU_SUSFS_ENABLE_LOG
	bool "Enable SUSFS kernel logging"
	depends on KSU_SUSFS
	default y
	help
	  Enable SUSFS informational and error messages in the kernel log.

config KSU_SUSFS_HIDE_KSU_SUSFS_SYMBOLS
	bool "Hide KernelSU and SUSFS symbols"
	depends on KSU_SUSFS
	default y
	help
	  Filter KernelSU and SUSFS symbols from proc kallsyms output.

config KSU_SUSFS_SPOOF_CMDLINE_OR_BOOTCONFIG
	bool "Enable bootconfig or cmdline spoofing"
	depends on KSU_SUSFS
	default y
	help
	  Replace proc bootconfig or proc cmdline output using configured data.

config KSU_SUSFS_OPEN_REDIRECT
	bool "Enable path-open redirection"
	depends on KSU_SUSFS
	default y
	help
	  Redirect a configured source path to another existing path.

config KSU_SUSFS_SUS_MAP
	bool "Enable mapped-file filtering"
	depends on KSU_SUSFS
	default y
	help
	  Filter configured file-backed mappings from supported proc interfaces.

endmenu

endmenu
```
